## CMakeLists.txt
```
# SPDX-License-Identifier: Apache-2.0

cmake_minimum_required(VERSION 3.20.0)

find_package(Zephyr REQUIRED HINTS $ENV{ZEPHYR_BASE})
project(hello_world)

target_sources(app PRIVATE src/main.c)

target_sources(app PRIVATE src/hardware.c)
target_sources(app PRIVATE src/radio.c)
target_sources(app PRIVATE src/app.c)
```

## prj.conf
```kconfig
# enable gpio driver
CONFIG_GPIO=y

# enable pwm soft-hardware driver
CONFIG_PWM=y
CONFIG_PWM_NRF5_SW=y

# enable uart driver
CONFIG_SERIAL=y

# enable console
CONFIG_CONSOLE=y
CONFIG_UART_CONSOLE=y

CONFIG_LOG=y
CONFIG_LOG_MODE_MINIMAL=y

# enable bluetoth
CONFIG_BT=y
CONFIG_BT_DEVICE_NAME="ST_water_dispenser"
CONFIG_BT_PERIPHERAL=y

#CONFIG_BT_LBS=y
#CONFIG_BT_LBS_POLL_BUTTON=y

# CONFIG_FPU=y 
```

## src/main.c
```c
#include <zephyr/kernel.h>

#include <zephyr/bluetooth/bluetooth.h>
#include <zephyr/bluetooth/gap.h>
#include <zephyr/bluetooth/uuid.h>
#include <zephyr/bluetooth/addr.h>

#include <zephyr/bluetooth/conn.h>

#include <zephyr/logging/log.h>
#include <zephyr/types.h>

#include "hardware.h"
#include "radio.h"
#include "app.h"

LOG_MODULE_REGISTER(main, LOG_LEVEL_DBG);



static struct hardware_cb hadware_callback = {
    .app_impuls_callback = app_one_impuls_callback
};

static struct api_water_dispenser radio_api = {
    .api_set_count = app_set_count,
    .api_get_count = app_get_count,
    .api_run = app_run,
    .api_run_stop = app_run_stop,
    .api_identify_on = app_identify_on,
    .api_identify_off = app_identify_off,
    .api_pump_on = app_pump_on,
    .api_pump_off = app_pump_off
};

static struct hardware_api hardware_api_impl = {
    .led_red_off = hadware_api_led_red_off,
    .led_red_on = hadware_api_led_red_on,
    .led_yellow_off = hadware_api_led_yellow_off,
    .led_yellow_on = hadware_api_led_yellow_on,
    .pump_off = hadware_api_pump_off,
    .pump_on = hadware_api_pump_on
};


void main(void)
{
    int err;
    LOG_INF("ST water dispenser app starts");

    
    err = hadware_api_init(&hadware_callback);
    if (err) {
        LOG_ERR("Hardware init failed (err %d)\n", err);
        return;
    }
    LOG_INF("hardware initalized");

    err = radio_api_init(&radio_api); 
    if (err) {
        LOG_ERR("Bluetooth init failed (err %d)\n", err);
        return;
    }
    LOG_INF("Bluetooth initialized\n");

    err = app_api_init(&hardware_api_impl); 
    if (err) {
        LOG_ERR("app init failed (err %d)\n", err);
        return;
    }
    LOG_INF("app initialized\n");


    LOG_INF("init finish device started!");
    while (1)
    {
        hardware_main_loop();
        app_main_loop_function();

        k_msleep(10);
    }
}
```

## src/app.c
```c
#include "app.h"


#include <zephyr/logging/log.h>

LOG_MODULE_DECLARE(app, LOG_LEVEL_DBG);

static struct hardware_api hardware;

static uint16_t impuls_count = 0;
static volatile uint16_t impuls_count_readed = 0;

static bool is_running = false;

static bool is_blinking = false;
static const uint16_t blinking_period = 10;
static uint16_t blinking_value = 0;
static bool blinking_on = false;


void app_set_count(const uint16_t count) {
    LOG_INF("setting impuls count: %d", impuls_count);
    impuls_count = count;
}

uint16_t app_get_count() {
    LOG_INF("reading impuls count: %d", impuls_count);
    return impuls_count_readed;
}

void app_run() {
    if (impuls_count == 0) {
        // error
        LOG_ERR("error - impuls_count == 0");
        return;
    }

    impuls_count_readed = 0;

    // run method

    LOG_INF("run method started, impuls: %d", impuls_count);

    is_running = true;
    hardware.pump_on();
    hardware.led_red_on();
}

void app_run_stop() {
    LOG_INF("run method stopped!");
    impuls_count = 0;
    is_running = false;
    hardware.pump_off();
    hardware.led_red_off();
}

//todo initalize in hardware
void app_one_impuls_callback() {
    // shardware made one impuls
    impuls_count_readed ++;
}

void app_identify_on() {
    // blinking on
    LOG_INF("identyfy start!");
    is_blinking = true;
    hardware.led_yellow_on();
}

void app_identify_off() {
    // stop blinking
    LOG_INF("identyfy stopped!");
    is_blinking = false;
    hardware.led_yellow_off();
}

void app_pump_on() {
    LOG_INF("pump on!");
    hardware.pump_on();
    hardware.led_red_on();
}

void app_pump_off() {
    LOG_INF("pump off!");
    hardware.pump_off();
    hardware.led_red_off();
}


void app_main_loop_function() {
    if(is_running) {
        if(impuls_count_readed >= impuls_count) {
            is_running = false;
            hardware.pump_off();
            hardware.led_red_off();

            LOG_INF("run method finished!");
        }
    }
    if(is_blinking) {
        if(blinking_value >= blinking_period) {
            if(blinking_on) {
                hardware.led_yellow_on();
                blinking_on = false;
            }
            else {
                hardware.led_yellow_off();
                blinking_on = true;
            }
            blinking_value = 0;
        } else {
            blinking_value++;
        }
    }
}


int app_api_init(struct hardware_api * api) {
    if(api) {
        hardware.led_red_off = api->led_red_off;
        hardware.led_red_on = api->led_red_on;
        hardware.led_yellow_off = api->led_yellow_off;
        hardware.led_yellow_on = api->led_yellow_on;
        hardware.pump_off = api->pump_off;
        hardware.pump_on = api->pump_on;

        return 0;
    }

    return 1;   
}
```

## src/app.h
```c
#ifndef APP_HH
#define APP_HH

#include <zephyr/types.h>
#include "hardware.h"

/* App content code */

/**
 * set count of impuls 
 * read count of impuls
 * 
 * start work
 * 
 * identify on
 * identify off
 * 
 * read all of impuls
*/

/* API */

void app_set_count(const uint16_t count);
uint16_t app_get_count();
void app_run();
void app_run_stop();
void app_identify_on();
void app_identify_off();
void app_pump_on();
void app_pump_off();


void app_one_impuls_callback(); 

void app_main_loop_function();


/* Hardware api */
typedef void (*api_pump_on)();
typedef void (*api_pump_off)();
typedef void (*api_led_red_on)();
typedef void (*api_led_red_off)();
typedef void (*api_led_yellow_on)();
typedef void (*api_led_yellow_off)();

struct hardware_api
{
    api_pump_on pump_on;
    api_pump_off pump_off;
    api_led_red_on led_red_on;
    api_led_red_off led_red_off;
    api_led_yellow_on led_yellow_on;
    api_led_yellow_off led_yellow_off;
};

int app_api_init(struct hardware_api * api);

#endif
```

## src/hardware.c
```c
#include "hardware.h"

#include <zephyr/kernel.h>
#include <zephyr/drivers/gpio.h>
#include <zephyr/drivers/pwm.h>


#include <zephyr/logging/log.h>

LOG_MODULE_DECLARE(hardware, LOG_LEVEL_DBG);

struct hardware_cb hardware_callbacks ;

struct gpio_dt_spec led_y = GPIO_DT_SPEC_GET(DT_NODELABEL(led0), gpios);
struct gpio_dt_spec led_r = GPIO_DT_SPEC_GET(DT_NODELABEL(led1), gpios);

struct gpio_dt_spec flow_input = GPIO_DT_SPEC_GET(DT_NODELABEL(flow_meter), gpios);
static struct gpio_callback flow_input_cb_data;

void pin_isr(const struct device *dev, struct gpio_callback *cb, uint32_t pins)
{
    if(hardware_callbacks.app_impuls_callback) {
        hardware_callbacks.app_impuls_callback();
    }
}

const struct pwm_dt_spec pump_pwm = PWM_DT_SPEC_GET(DT_NODELABEL(pump));



static int init_hardware() {
    int err = 0;
    
    /**
     * Checks all devices
    */
    if (!device_is_ready(led_y.port) || !device_is_ready(led_r.port) || !device_is_ready(flow_input.port) || !device_is_ready(pump_pwm.dev)) {
        return err;
    }

    /**
     * initailize outputs for leds
    */
    err = gpio_pin_configure_dt(&led_y, GPIO_OUTPUT_ACTIVE);
    if (err < 0) {
        return err;
    }

    err = gpio_pin_configure_dt(&led_r, GPIO_OUTPUT_ACTIVE);
    if (err < 0) {
        return err;
    }

    /**
     * initailize input
    */
    err = gpio_pin_configure_dt(&flow_input, GPIO_INPUT);
    if (err < 0) {
        return err;
    }
    err = gpio_pin_interrupt_configure_dt(&flow_input,GPIO_INT_EDGE_TO_ACTIVE);
    if (err < 0) {
        return err;
    }
    gpio_init_callback(&flow_input_cb_data, pin_isr, BIT(flow_input.pin));
    gpio_add_callback(flow_input.port, &flow_input_cb_data);

    /**
     * initailize pwm output
    */
    pwm_set_dt(&pump_pwm, 1000000, 0); 

    /**
     * set default values
    */
    hadware_api_led_red_on();
    hadware_api_led_yellow_on();

    k_msleep(10);

    hadware_api_led_red_off();
    hadware_api_led_yellow_off();
    hadware_api_pump_off();

    return err;
}



int hadware_api_init(struct hardware_cb *callbacks) {
    if(callbacks) {
        hardware_callbacks.app_impuls_callback = callbacks->app_impuls_callback;
    }

    return init_hardware();
}

void hadware_api_pump_on() {
    pwm_set_dt(&pump_pwm, 1000000, 1000000); 
}

void hadware_api_pump_off() {
    pwm_set_dt(&pump_pwm, 1000000, 0); 
}

void hadware_api_led_red_on() {
    gpio_pin_set_dt(&led_r, 1);
}

void hadware_api_led_red_off() {
    gpio_pin_set_dt(&led_r, 0);
}

void hadware_api_led_yellow_on() {
    gpio_pin_set_dt(&led_y, 1);
}

void hadware_api_led_yellow_off() {
    gpio_pin_set_dt(&led_y, 0);
}


void hardware_main_loop() {
   // gpio_pin_toggle_dt(&led_r);
}
```

## src/hardware.h
```c
#ifndef HARDWARE_HH
#define HARDWARE_HH

#include <stdbool.h>

/* API */

void hadware_api_pump_on();
void hadware_api_pump_off();
void hadware_api_led_red_on();
void hadware_api_led_red_off();
void hadware_api_led_yellow_on();
void hadware_api_led_yellow_off();


/**
 * function run in main loop every 10 ms
*/
void hardware_main_loop(void);


typedef void (*api_impuls_callback_t)();

struct hardware_cb {
	api_impuls_callback_t    app_impuls_callback;
};


int hadware_api_init(struct hardware_cb *callbacks);

#endif
```

## src/radio.c
```c
#include "radio.h"


#include <zephyr/bluetooth/bluetooth.h>
#include <zephyr/bluetooth/hci.h>
#include <zephyr/bluetooth/conn.h>
#include <zephyr/bluetooth/uuid.h>
#include <zephyr/bluetooth/gatt.h>
#include <zephyr/logging/log.h>

LOG_MODULE_DECLARE(radio, LOG_LEVEL_DBG);

static struct api_water_dispenser api_callbacks;


static uint16_t imps = 0;

ssize_t bt_impset_read(struct bt_conn *conn,
					     const struct bt_gatt_attr *attr,
					     const void *buf, uint16_t len,
					     uint16_t offset, uint8_t flags) 
{
	LOG_INF("bt_impset_read");
	
	uint16_t *value = attr->user_data;
	
	return bt_gatt_attr_read(conn, attr, buf, len, offset, value, sizeof(*value));
}	

ssize_t bt_impset_write(struct bt_conn *conn,
					     const struct bt_gatt_attr *attr,
					     const void *buf, uint16_t len,
					     uint16_t offset, uint8_t flags) 
{
	LOG_INF("bt_impset_write");
	LOG_DBG("data len: %d, offset: %d, flags: %d", len, offset, flags);

	uint16_t val = *((uint16_t *)buf);

	LOG_INF("value: %d", val);

	imps = val;

	if(api_callbacks.api_set_count) {
		api_callbacks.api_set_count(imps);
	};

	return len;
}	

ssize_t bt_run(struct bt_conn *conn,
					     const struct bt_gatt_attr *attr,
					     const void *buf, uint16_t len,
					     uint16_t offset, uint8_t flags) 
{
	LOG_INF("bt_run");
	LOG_DBG("data len: %d, offset: %d, flags: %d", len, offset, flags);

	LOG_DBG("Attribute write, handle: %u, conn: %p", attr->handle, (void *)conn);

	if (len != 1U) {
		LOG_DBG("Write led: Incorrect data length");
		return BT_GATT_ERR(BT_ATT_ERR_INVALID_ATTRIBUTE_LEN);
	}

	if (offset != 0) {
		LOG_DBG("Write led: Incorrect data offset");
		return BT_GATT_ERR(BT_ATT_ERR_INVALID_OFFSET);
	}

	if (api_callbacks.api_run) {
		uint8_t val = *((uint8_t *)buf);

		if (val == 0x01) {
			api_callbacks.api_run();
			imps = 0;
		} else if (val == 0x00) {
			api_callbacks.api_run_stop();
			imps = 0;
		}
		else {
			LOG_DBG("Write led: Incorrect value");
			return BT_GATT_ERR(BT_ATT_ERR_VALUE_NOT_ALLOWED);
		}
	}

	return len;
}	

ssize_t bt_identify(struct bt_conn *conn,
					     const struct bt_gatt_attr *attr,
					     const void *buf, uint16_t len,
					     uint16_t offset, uint8_t flags) 
{
	LOG_INF("bt_identify");

	LOG_DBG("data len: %d, offset: %d, flags: %d", len, offset, flags);

	if (len != 1U) {
		LOG_DBG("Write led: Incorrect data length");
		return BT_GATT_ERR(BT_ATT_ERR_INVALID_ATTRIBUTE_LEN);
	}

	if (offset != 0) {
		LOG_DBG("Write led: Incorrect data offset");
		return BT_GATT_ERR(BT_ATT_ERR_INVALID_OFFSET);
	}

	if (api_callbacks.api_run) {
		uint8_t val = *((uint8_t *)buf);

		if (val == 0x01) {
			api_callbacks.api_identify_on();
		} else if (val == 0x00) {
			api_callbacks.api_identify_off();
		}
		else {
			LOG_DBG("Write led: Incorrect value");
			return BT_GATT_ERR(BT_ATT_ERR_VALUE_NOT_ALLOWED);
		}
	}

	return len;
}	

ssize_t bt_on_off(struct bt_conn *conn,
					     const struct bt_gatt_attr *attr,
					     const void *buf, uint16_t len,
					     uint16_t offset, uint8_t flags) 
{
	LOG_INF("bt_on_off");
	LOG_DBG("data len: %d, offset: %d, flags: %d", len, offset, flags);

	LOG_DBG("Attribute write, handle: %u, conn: %p", attr->handle, (void *)conn);

	if (len != 1U) {
		LOG_DBG("Write led: Incorrect data length");
		return BT_GATT_ERR(BT_ATT_ERR_INVALID_ATTRIBUTE_LEN);
	}

	if (offset != 0) {
		LOG_DBG("Write led: Incorrect data offset");
		return BT_GATT_ERR(BT_ATT_ERR_INVALID_OFFSET);
	}

	if (api_callbacks.api_run) {
		uint8_t val = *((uint8_t *)buf);

		if (val == 0x01) {
			api_callbacks.api_pump_on();
		} else if (val == 0x00) {
			api_callbacks.api_pump_off();
		}
		else {
			LOG_DBG("Write led: Incorrect value");
			return BT_GATT_ERR(BT_ATT_ERR_VALUE_NOT_ALLOWED);
		}
	}

	return len;
}	

BT_GATT_SERVICE_DEFINE(my_lbs_svc,
	BT_GATT_PRIMARY_SERVICE(BT_UUID_WATER_DISPENSER),
	BT_GATT_CHARACTERISTIC(BT_UUID_IMPUSET,
					(BT_GATT_CHRC_WRITE | BT_GATT_CHRC_READ),
					(BT_GATT_PERM_WRITE | BT_GATT_PERM_READ), 
					bt_impset_read, 
					bt_impset_write,
					&imps),
	BT_GATT_CHARACTERISTIC(BT_UUID_RUN,
					BT_GATT_CHRC_WRITE,
					BT_GATT_PERM_WRITE,
					NULL,
					bt_run,
					NULL),
	BT_GATT_CHARACTERISTIC(BT_UUID_IDENTIFY,
					BT_GATT_CHRC_WRITE,
					BT_GATT_PERM_WRITE,
					NULL,
					bt_identify,
					NULL),
	BT_GATT_CHARACTERISTIC(BT_UUID_ON_OFF,
					BT_GATT_CHRC_WRITE,
					BT_GATT_PERM_WRITE,
					NULL,
					bt_on_off,
					NULL),
);


#define COMPANY_ID_CODE            0x0059

typedef struct adv_mfg_data {
	uint16_t company_code;	    /* Company Identifier Code. */
	uint16_t number_press;      /* Number of times Button 1 is pressed*/
} adv_mfg_data_type;


static adv_mfg_data_type adv_mfg_data = {COMPANY_ID_CODE,0x00};

/*advertising packet*/
static const struct bt_data ad[] = {
	/* STEP 4.1.2 - Set the advertising flags */    
    BT_DATA_BYTES(BT_DATA_FLAGS, (BT_LE_AD_GENERAL | BT_LE_AD_NO_BREDR)),
	/* STEP 4.1.3 - Set the advertising packet data  */
    BT_DATA(BT_DATA_NAME_COMPLETE, CONFIG_BT_DEVICE_NAME, sizeof(CONFIG_BT_DEVICE_NAME) - 1),
    BT_DATA(BT_DATA_MANUFACTURER_DATA,(unsigned char *)&adv_mfg_data, sizeof(adv_mfg_data)),
};


/*scan response*/
static const struct bt_data sd[] = {
        /* 4.2.3 Include the URL data in the scan response packet*/
        BT_DATA_BYTES(BT_DATA_UUID128_ALL, BT_UUID_WATER_DISPENSER_ENCODED),
};



static struct bt_le_adv_param *adv_param =
	BT_LE_ADV_PARAM(BT_LE_ADV_OPT_CONNECTABLE,
	800,
	801,
	NULL);


/* ---BLE CONNECTION--- */

struct bt_conn *my_conn = NULL;



static void on_connected(struct bt_conn *conn, uint8_t err)
{
    if (err) {
        LOG_ERR("Connection error %d", err);
        return;
    }
    LOG_INF("Connected");
    my_conn = bt_conn_ref(conn);
    
    struct bt_conn_info info;
    err = bt_conn_get_info(conn, &info);
    if (err) {
        LOG_ERR("bt_conn_get_info() returned %d", err);
        return;
    }
    uint16_t connection_interval = (uint16_t)info.le.interval*1.25; // in ms
    uint16_t supervision_timeout = info.le.timeout*10; // in ms
    LOG_INF("Connection parameters: interval %.2d ms, latency %d intervals, timeout %d ms", connection_interval, info.le.latency, supervision_timeout);
}
static void on_disconnected(struct bt_conn *conn, uint8_t reason)
{
    LOG_INF("Disconnected. Reason %d", reason);
    bt_conn_unref(my_conn);
    
	api_callbacks.api_identify_off();
}

static struct bt_conn_cb connection_callbacks = {
    .connected              = on_connected,
    .disconnected           = on_disconnected,
};


/* ---BLE CONNECTION--- */


static int radio_init() {
	int err;

	err = bt_enable(NULL); 
    if (err) {
        LOG_ERR("Bluetooth enabled failed (err %d)\n", err);
        return err;
    }
    LOG_INF("Bluetooth enabled\n");

	bt_addr_le_t addr;
    err = bt_addr_le_from_str("FF:EE:DD:CC:BB:AA", "random", &addr);
    if (err) {
        LOG_ERR("Invalid BT address (err %d)\n", err);
    }
    err = bt_id_create(&addr, NULL);
    if (err < 0) {
        LOG_ERR("Creating new ID failed (err %d)\n", err);
    }   

    bt_conn_cb_register(&connection_callbacks);

    err = bt_le_adv_start(adv_param, ad, ARRAY_SIZE(ad),
			      sd, ARRAY_SIZE(sd));
	if (err) {
		LOG_ERR("Advertising failed to start (err %d)\n", err);
		return err;
	}

	return err;
}



int radio_api_init(struct api_water_dispenser *callbacks) {
	if(callbacks) {
		api_callbacks.api_get_count = callbacks->api_get_count;
		api_callbacks.api_set_count = callbacks->api_set_count;
		api_callbacks.api_identify_off = callbacks->api_identify_off;
		api_callbacks.api_identify_on = callbacks->api_identify_on;
		api_callbacks.api_run = callbacks->api_run;
		api_callbacks.api_run_stop = callbacks->api_run_stop;
		api_callbacks.api_pump_on = callbacks->api_pump_on;
		api_callbacks.api_pump_off = callbacks->api_pump_off;
	}

	return radio_init();
}
```

## src/radio.h
```c
#ifndef RADIO_HH
#define RADIO_HH

#include <zephyr/types.h>
#include <stdbool.h>

// #define BT_UUID_LBS_VAL         BT_UUID_128_ENCODE(0x00001523, 0x1212, 0xefde, 0x1523, 0x785feabcd123)
// /** @brief Button Characteristic UUID. */
// #define BT_UUID_LBS_BUTTON_VAL  BT_UUID_128_ENCODE(0x00001524, 0x1212, 0xefde, 0x1523, 0x785feabcd123)
// /** @brief LED Characteristic UUID. */
// #define BT_UUID_LBS_LED_VAL     BT_UUID_128_ENCODE(0x00001525, 0x1212, 0xefde, 0x1523, 0x785feabcd123)

// #define BT_UUID_LBS           BT_UUID_DECLARE_128(BT_UUID_LBS_VAL)
// #define BT_UUID_LBS_BUTTON    BT_UUID_DECLARE_128(BT_UUID_LBS_BUTTON_VAL)
// #define BT_UUID_LBS_LED       BT_UUID_DECLARE_128(BT_UUID_LBS_LED_VAL)


#define BT_UUID_WATER_DISPENSER_ENCODED     BT_UUID_128_ENCODE(0x12345678, 0x1234, 0x5678, 0x1234, 0x56789abcdef1)
#define BT_UUID_WATER_DISPENSER     BT_UUID_DECLARE_128(BT_UUID_WATER_DISPENSER_ENCODED)

#define BT_UUID_IMPUSET             BT_UUID_DECLARE_128(BT_UUID_128_ENCODE(0x12345678, 0x1234, 0x5678, 0x1234, 0x56789abcdef2))
#define BT_UUID_RUN                 BT_UUID_DECLARE_128(BT_UUID_128_ENCODE(0x12345678, 0x1234, 0x5678, 0x1234, 0x56789abcdef3))
#define BT_UUID_IDENTIFY            BT_UUID_DECLARE_128(BT_UUID_128_ENCODE(0x12345678, 0x1234, 0x5678, 0x1234, 0x56789abcdef4))
#define BT_UUID_ON_OFF              BT_UUID_DECLARE_128(BT_UUID_128_ENCODE(0x12345678, 0x1234, 0x5678, 0x1234, 0x56789abcdef5))



// /** @brief Callback type for when an LED state change is received. */
// typedef void (*led_cb_t)(const bool led_state);

// /** @brief Callback type for when the button state is pulled. */
// typedef bool (*button_cb_t)(void);

// /** @brief Callback struct used by the LBS Service. */
// struct my_lbs_cb {
// 	/** LED state change callback. */
// 	led_cb_t    led_cb;
// 	/** Button read callback. */
// 	button_cb_t button_cb;
// };


// int my_lbs_init(struct my_lbs_cb *callbacks);



typedef void (*api_set_count_t)(const uint16_t count);
typedef uint16_t (*api_get_count_t)();
typedef void (*api_run_t)();
typedef void (*api_run_stop_t)();
typedef void (*api_identify_on_t)();
typedef void (*api_identify_off_t)();
typedef void (*api_pump_on_t)();
typedef void (*api_pump_off_t)();

struct api_water_dispenser {
	api_set_count_t api_set_count;
    api_get_count_t api_get_count;
    api_run_t api_run;
    api_run_stop_t api_run_stop;
    api_identify_on_t api_identify_on;
    api_identify_off_t api_identify_off;
    api_pump_on_t api_pump_on;
    api_pump_off_t api_pump_off;
};

int radio_api_init(struct api_water_dispenser *callbacks);

#endif
```
